/* LicheeRV-Nano GC4653 camera overlay (mainline).
 *
 * Board wiring recovered from the vendor tree (sipeed/LicheeRV-Nano-Build):
 *  - buildroot .../sensor_cfg.ini.beta: sensor on I2C bus 4 at 0x29,
 *    lane map clock=4 data=<3 2>, mclk id 1.
 *  - u-boot cvi_board_init.c (sg2002_licheervnano_sd): camera I2C is IIC4
 *    muxed onto the RTC-domain pins PWR_WAKEUP0 (reg 0x03001090, func 5 =
 *    IIC4_SCL) and PWR_BUTTON1 (0x03001098, func 5 = IIC4_SDA) — the vendor
 *    comments mislabel them "PWR_GPIO6/8", and CAM_MCLK1 out on the analog
 *    pad PAD_MIPIRX0N (0x0300118c, func 5). None of that survives into a
 *    mainline FIP, so pinctrl below redoes it.
 *  - sg2002_licheervnano_sd.dts: &mipi_rx snsr-reset = GPIOE1 active low.
 *
 * Fixed mode 2560x1440p30 SRGGB10 over two data lanes. Power-up is xvclk
 * (CAM_MCLK1, 24 MHz) + reset deassert, both owned by the gc4653 driver's
 * power-on path; the driver keeps the sensor clocked after probe so capture
 * can take ownership of stream on/off.
 */

#include <dt-bindings/clock/sophgo,cv1800.h>
#include <dt-bindings/gpio/gpio.h>

/*
 * The standalone DTB builder uses an unpatched Linux source tarball. Keep
 * these fallbacks until its cv18xx-reset.h contains the named CSI PHY IDs.
 */
#ifndef RST_CSI_PHY0
#define RST_CSI_PHY0 70
#endif
#ifndef RST_CSI_PHY0_APB
#define RST_CSI_PHY0_APB 71
#endif

/* BISECT: camera overlay fully stripped - tests initrd/kernel on plain bw base */
/* BISECT: camera overlay fully stripped - tests initrd/kernel on plain bw base */
