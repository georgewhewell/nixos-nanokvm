/* Identity for the LicheeRV Nano B-W module. */

/ {
	model = "Sipeed LicheeRV Nano B-W";
	compatible = "sipeed,licheerv-nano-bw",
		     "sipeed,licheerv-nano-b",
		     "sipeed,licheerv-nano",
		     "sophgo,sg2002";

};
